## sdkconfig.defaults
```kconfig
CONFIG_USB_DEVICE_ENABLED=y
CONFIG_USB_DEVICE_UAC2=y
CONFIG_USB_AUDIO_ENABLED=y
CONFIG_AUDIO_SUPPORT=y
CONFIG_FREERTOS_HZ=1000
CONFIG_CODEC_I2C_BACKWARD_COMPATIBLE=n
```
